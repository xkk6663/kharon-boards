## boards/espressif/korvo1/Kconfig.korvo1
```kconfig
# ESP32-S31-Korvo-1 configuration

# Copyright (c) 2026 Espressif Systems (Shanghai) Co., Ltd.
# SPDX-License-Identifier: Apache-2.0

config BOARD_KORVO1
	select SOC_ESP32S31_HPCORE if BOARD_KORVO1_ESP32S31_HPCORE
	select SOC_ESP32S31_REV_0_0
```

## boards/espressif/korvo1/board.yml
```yaml
# kharon-boards/boards/espressif/korvo1/board.yml
board:
  name: korvo1
  full_name: ESP32-S31-Korvo-1
  vendor: espressif
  socs:
  - name: esp32s31
```

## boards/st/stm32f103c8t6_bluepill/Kconfig.stm32f103c8t6_bluepill
```kconfig
# SPDX-License-Identifier: Apache-2.0

config BOARD_STM32F103C8T6_BLUEPILL
	select SOC_STM32F103X8
```

## boards/st/stm32f103c8t6_bluepill/board.yml
```yaml
board:
  name: stm32f103c8t6_bluepill
  full_name: Blue Pill STM32F103C8T6
  vendor: st
  socs:
    - name: stm32f103x8
```

## boards/st/stm32f103c8t6_bluepill/stm32f103c8t6_bluepill_defconfig
```kconfig
# SPDX-License-Identifier: Apache-2.0

# enable uart driver / console
CONFIG_SERIAL=y
CONFIG_CONSOLE=y
CONFIG_UART_CONSOLE=y

# enable GPIO
CONFIG_GPIO=y
```
